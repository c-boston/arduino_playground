#include <TinyGPS++.h>
#include <SoftwareSerial.h>
#include <SD.h>
#include <SPI.h>

File myFile;
TinyGPSPlus gps;

SoftwareSerial ss(3, 4);

struct Point 
{
 float x;
 float y;
};

int pnpoly(int nvert, Point verts[], Point test)
{
  int i, j, c = 0;
  float x = test.x;
  float y = test.y;
  
  for (i = 0, j = nvert-1; i < nvert; j = i++) {
      float xi = verts[i].x;
      float yi = verts[i].y;
      float xj = verts[j].x;
      float yj = verts[j].y;
      
    if ( (yi > y != yj > y) && x < ((xj - xi) * (y - yi)) / (yj - yi) + xi )
       c = !c;
  }
  
  return c;
}

static const int MAX_NUMBER_POINTS = 35; // each point takes 8 bytes ~ 35 thru trial and error
Point points[MAX_NUMBER_POINTS];
int pIdx = 0;
int numberOfPoints;

void setup() {
  Serial.begin(9600);
  ss.begin(9600);
  
  if (!SD.begin(5)) {
    Serial.println("Failed to initialize SD card");
    while (1);
  }
  
  Serial.print("MAX_NUMBER_POINTS: ");
  Serial.println(MAX_NUMBER_POINTS);
  
  myFile = SD.open("POINTS.txt");
  if (myFile) {
    while (myFile.available() && pIdx < MAX_NUMBER_POINTS) {
      String line = myFile.readStringUntil('\n');
      
      int i = line.indexOf(",");
      if (i > -1){
        float lat = line.substring(0, i).toFloat();
        Serial.print(lat, 6);
        Serial.print(", "); 
        float lng = line.substring(i + 1).toFloat();
        Serial.println(lng, 6);
        
        points[pIdx] = {lat, lng};
        pIdx++;        
      }      
    }
    myFile.close();
  } else {
    Serial.println("error opening file");
  }  
  SPI.end();  
  
  numberOfPoints = pIdx;
  Serial.print("Number of points imported: ");
  Serial.println(numberOfPoints);
  
  pinMode(LED_BUILTIN, OUTPUT);  
  
  Serial.println("\n-----");
}

void loop(){
  while (ss.available() > 0){
    gps.encode(ss.read());
    if (gps.location.isUpdated()){
      Serial.print(gps.location.lat(), 6);
      Serial.print(", "); 
      Serial.print(gps.location.lng(), 6);
      
      if (pnpoly(numberOfPoints, points, { gps.location.lat(), gps.location.lng() })) {
        Serial.println(" - INSIDE");
        digitalWrite(LED_BUILTIN, HIGH);
      } else {
        Serial.println(" - OUTSIDE");
        digitalWrite(LED_BUILTIN, LOW);
      }
    }
  }
}
